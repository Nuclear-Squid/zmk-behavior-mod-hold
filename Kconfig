## Kconfig
```kconfig
config ZMK_BEHAVIOR_MOD_HOLD
  bool
  default y
  depends on DT_HAS_ZMK_BEHAVIOR_MOD_HOLD_ENABLED \
          || DT_HAS_ZMK_BEHAVIOR_MOD_HOLD_ONE_PARAM_ENABLED \
          || DT_HAS_ZMK_BEHAVIOR_MOD_HOLD_TWO_PARAM_ENABLED
```

## dts/bindings/behaviors/zmk,behavior-mod-hold-one-param.yaml
```yaml
compatible: "zmk,behavior-mod-hold-one-param"
include: [mod-hold-base.yaml, one_param.yaml]
```

## dts/bindings/behaviors/zmk,behavior-mod-hold-two-param.yaml
```yaml
compatible: "zmk,behavior-mod-hold-two-param"
include: [mod-hold-base.yaml, two_param.yaml]
```

## dts/bindings/behaviors/zmk,behavior-mod-hold.yaml
```yaml
compatible: "zmk,behavior-mod-hold"
include: [mod-hold-base.yaml, zero_param.yaml]
```
